## main/Kconfig.projbuild
```kconfig
menu "Home Panel"

config PANEL_WIFI_SSID
    string "Wi-Fi SSID"
    default ""

config PANEL_WIFI_PASSWORD
    string "Wi-Fi password"
    default ""

config PANEL_MQTT_URI
    string "MQTT broker URI"
    default "mqtt://192.168.1.2"

config PANEL_MQTT_USERNAME
    string "MQTT username"
    default ""

config PANEL_MQTT_PASSWORD
    string "MQTT password"
    default ""

config PANEL_MQTT_BASE_TOPIC
    string "MQTT runtime base topic"
    default "home/7c-panel"

config PANEL_MQTT_DISCOVERY_PREFIX
    string "Home Assistant MQTT discovery prefix"
    default "homeassistant"

config PANEL_TIMEZONE
    string "POSIX timezone"
    default "EST5EDT,M3.2.0/2,M11.1.0/2"

choice PANEL_THEME
    prompt "Panel theme"
    default PANEL_THEME_CLASSIC

config PANEL_THEME_CLASSIC
    bool "Classic dark"

config PANEL_THEME_SOCCER
    bool "Soccer green"

config PANEL_THEME_KITTENS
    bool "Kittens pink"

config PANEL_THEME_MAGIC
    bool "Magic / bricks blue"

endchoice

config PANEL_BACKLIGHT
    int "Backlight brightness percent"
    range 5 100
    default 100

endmenu
```

## sdkconfig.defaults
```kconfig
CONFIG_IDF_TARGET="esp32s3"
CONFIG_BOOTLOADER_APP_ROLLBACK_ENABLE=y
CONFIG_ESP_DEFAULT_CPU_FREQ_MHZ_240=y

CONFIG_ESPTOOLPY_FLASHMODE_QIO=y
CONFIG_ESPTOOLPY_FLASHFREQ_80M=y
CONFIG_ESPTOOLPY_FLASHSIZE_16MB=y

CONFIG_SPIRAM=y
CONFIG_SPIRAM_MODE_OCT=y
CONFIG_SPIRAM_SPEED_80M=y
CONFIG_SPIRAM_FETCH_INSTRUCTIONS=y
CONFIG_SPIRAM_RODATA=y
CONFIG_SPIRAM_USE_MALLOC=y
CONFIG_SPIRAM_ALLOW_BSS_SEG_EXTERNAL_MEMORY=y

CONFIG_PARTITION_TABLE_CUSTOM=y
CONFIG_PARTITION_TABLE_CUSTOM_FILENAME="partitions.csv"

CONFIG_FREERTOS_HZ=1000
CONFIG_ESP32S3_DATA_CACHE_LINE_64B=y
CONFIG_COMPILER_OPTIMIZATION_SIZE=y
# CONFIG_COMPILER_OPTIMIZATION_PERF is not set

CONFIG_LV_COLOR_DEPTH_16=y
CONFIG_LV_USE_CLIB_MALLOC=y

# The display framebuffer is RGB565, but all illustrated theme sprites are
# transparent ARGB8888 source images.  LVGL must have both the RGB565 target
# blender and ARGB8888 source blender enabled.
CONFIG_LV_USE_DRAW_SW=y
CONFIG_LV_DRAW_SW_SUPPORT_RGB565=y
CONFIG_LV_DRAW_SW_SUPPORT_ARGB8888=y
CONFIG_LV_DRAW_SW_SUPPORT_ARGB8888_PREMULTIPLIED=y

CONFIG_LV_USE_LOG=y
CONFIG_LV_LOG_PRINTF=y

CONFIG_LV_FONT_MONTSERRAT_14=y
CONFIG_LV_FONT_MONTSERRAT_16=y
CONFIG_LV_FONT_MONTSERRAT_18=y
CONFIG_LV_FONT_MONTSERRAT_20=y
CONFIG_LV_FONT_MONTSERRAT_22=y
CONFIG_LV_FONT_MONTSERRAT_24=y
CONFIG_LV_FONT_MONTSERRAT_28=y
CONFIG_LV_FONT_MONTSERRAT_32=y
CONFIG_LV_FONT_MONTSERRAT_36=y

CONFIG_LV_USE_CANVAS=y

# CONFIG_LV_USE_VECTOR_GRAPHIC is not set
# CONFIG_LV_USE_THORVG is not set
# CONFIG_LV_USE_THORVG_INTERNAL is not set
# CONFIG_LV_USE_SVG is not set

# CONFIG_ESP_WIFI_IRAM_OPT is not set
# CONFIG_ESP_WIFI_RX_IRAM_OPT is not set
# CONFIG_ESP_WIFI_EXTRA_IRAM_OPT is not set
# CONFIG_ESP_WIFI_SLP_IRAM_OPT is not set
CONFIG_SPIRAM_TRY_ALLOCATE_WIFI_LWIP=y
```
